## conf/machine/hio-imx6dl-iob3200.conf
```bitbake
#@TYPE: Machine
#@NAME: hio mx6 iob3200
#@SOC: i.MX6DL
#@DESCRIPTION: Machine configuration for habey hio board

require conf/machine/include/imx-base.inc
require conf/machine/include/tune-cortexa9.inc

SOC_FAMILY = "mx6:mx6dl"

#UBOOT_SUFFIX = "imx"
#UBOOT_PADDING = "2"
PREFERRED_PROVIDER_u-boot = "u-boot-hio-imx6"
PREFERRED_VERSION_u-boot-hio-imx6 = "2015.04"

#kernel
KERNEL_DEVICETREE = "hio-imx6dl-iob3200.dtb"
KERNEL_IMAGETYPE = "zImage"
PREFERRED_PROVIDER_virtual/kernel ?= "linux-hio-imx6"
PREFERRED_VERSION_linux-hio-imx6 ?= "3.14.52"

UBOOT_MACHINE = "hio-imx6dl-board-spl_config"
SERIAL_CONSOLE = "115200 ttymxc1"

MACHINE_FEATURES += " pci bluetooh wifi "

MACHINE_FIRMWARE += " firmware-imx-epdc " 
MACHINE_FIRMWARE_append_imx6 = " linux-firmware-ath6k "
```
